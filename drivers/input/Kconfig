## drivers/input/Kconfig
```kconfig
# SPDX-License-Identifier: MIT

config INPUT_MLX90393
	bool "MLX90393 magnetometer sensor input driver"
	default y
	depends on DT_HAS_MELEXIS_MLX90393_ENABLED
	help
	  MLX90393 magnetometer sensor input driver
```

## dts/bindings/input/melexis,mlx90393-common.yaml
```yaml
# SPDX-License-Identifier: MIT

properties:
  irq-gpios:
    type: phandle-array
    description: Data ready gpio, INT pin on MLX90393

  no-x:
    type: boolean
    description: skip measure x axis on chip (default read xyz)
 
  no-y:
    type: boolean
    description: skip measure y axis on chip (default read xyz)

  no-z:
    type: boolean
    description: skip measure z axis on chip (default read xyz)

  calib-cycle:
    type: int
    default: 100
    description: count of auto calibration cycle

  woc-thd-trim-pctg:
    type: int
    default: 75
    description: |
      Percentage to trim calibration results before setup wake-on-change threshold.
      Adjust this to filter extreme cases of samples during calibration.

  ex-woc-thd-xy:
    type: int
    default: 0
    description: extra delta for XY-axis wake-on-change threshold

  ex-woc-thd-z:
    type: int
    default: 0
    description: extra delta for Z-axis wake-on-change threshold

  smooth-len:
    type: int
    default: 5
    description: Number of samples for smoothing

  downshift:
    type: int
    default: 25
    description: |
      Maximum in-deadzone-interrupts in burst mode before downshift to wake-on change mode.
      Interrupt interval is hardcode to ~20ms, default 25 * ~20ms = 500ms downshift

  rpt-dzn-x:
    type: int
    default: 150
    description: X-axis deadzone

  rpt-dzn-y:
    type: int
    default: 150
    description: Y-axis deadzone

  rpt-dzn-z:
    type: int
    default: 150
    description: Z-axis deadzone
```

## dts/bindings/input/melexis,mlx90393-i2c.yaml
```yaml
# SPDX-License-Identifier: MIT

description: |
  MLX90393 magnetometer sensor input driver

compatible: "melexis,mlx90393"

include: [base.yaml, i2c-device.yaml, "melexis,mlx90393-common.yaml"]
```

## dts/bindings/input/melexis,mlx90393-spi.yaml
```yaml
# SPDX-License-Identifier: MIT

description: |
  MLX90393 magnetometer sensor input driver

compatible: "melexis,mlx90393"

include: [base.yaml, spi-device.yaml, "melexis,mlx90393-common.yaml"]
```
